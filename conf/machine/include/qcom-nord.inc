## conf/machine/include/qcom-nord.inc
```bitbake
# Configurations and variables for Nord SoC family.

SOC_FAMILY = "nord"
require conf/machine/include/qcom-base.inc
require conf/machine/include/qcom-common.inc

DEFAULTTUNE = "armv8-6a-crypto"
require conf/machine/include/arm/arch-armv8-6a.inc

MACHINE_ESSENTIAL_EXTRA_RRECOMMENDS += " \
    packagegroup-qcom-boot-essential \
    packagegroup-machine-essential-qcom-nord-soc \
"

MACHINE_EXTRA_RRECOMMENDS += " \
    packagegroup-qcom-boot-additional \
"

# Memory layout needed by the SPL FIT boot flow.
QCOM_UBOOT_SPL_ENTRY ?= "0x0C219000"
UBOOT_FIT_ARM_TRUSTED_FIRMWARE_LOADADDRESS ?= "0xBC300000"
UBOOT_FIT_ARM_TRUSTED_FIRMWARE_ENTRYPOINT ?= "0xBC300000"
UBOOT_FIT_TEE_LOADADDRESS ?= "0xBC600000"
UBOOT_FIT_TEE_ENTRYPOINT ?= "0xBC600000"
UBOOT_FIT_UBOOT_LOADADDRESS ?= "0xD8D00000"
UBOOT_FIT_UBOOT_ENTRYPOINT ?= "0xD8D00000"

# Recipes providing BL31 and OP-TEE for the FIT.
QCOM_UBOOT_SPL_FIT_ATF ?= "trusted-firmware-a-qcom-nord"
QCOM_UBOOT_SPL_FIT_TEE ?= "optee-os-qcom-nord"
```

## recipes-bsp/tfa-optee-uboot-fit/files/tfa-optee-uboot-spl.its
```
/dts-v1/;

/ {
    description = "TFA + OP-TEE + U-Boot FIT Image for SPL";
    #address-cells = <1>;

    images {

        /* ------------------------ */
        /*  BL31 (ARM Trusted FW)   */
        /* ------------------------ */
        tfa {
            description = "ARM Trusted Firmware";
            data = /incbin/("bl31.bin");
            type = "firmware";
            arch = "arm64";
            os = "arm-trusted-firmware";
            compression = "none";
            load = <0xBC300000>;
            entry = <0xBC300000>;

            hash-1 {
                algo = "sha256";
            };
        };

        /* ------------------------ */
        /*  BL32 (OP-TEE)           */
        /* ------------------------ */
        optee {
            description = "OP-TEE Secure OS";
            data = /incbin/("tee-raw.bin");
            type = "tee";
            arch = "arm64";
            os = "tee";
            compression = "none";
            load = <0xBC600000>;
            entry = <0xBC600000>;

            hash-1 {
                algo = "sha256";
            };
        };
	 /* ------------------------ */
        /*  TZ_AC_CFG           */
        /* ------------------------ */
        tz_ac_config {
            description = "TZ AC Config";
            data = /incbin/("tz_ac_config.bin");
            type = "tee";
            arch = "arm64";
            compression = "none";
            load = <0xBC000000>;
            entry = <0xBC000000>;

            hash-1 {
                algo = "sha256";
            };
        };
        /* ------------------------ */
        /*  BL33 (U-Boot)           */
        /* ------------------------ */
        uboot {
            description = "U-Boot Bootloader";
            data = /incbin/("u-boot.bin");
            type = "standalone";
            arch = "arm64";
            os = "u-boot";
            compression = "none";
            load = <0xd8d00000>;
            entry = <0xd8d00000>;

            hash-1 {
                algo = "sha256";
            };
        };
    };

    /* ---------------------------- */
    /*  CONFIGURATION               */
    /* ---------------------------- */
    configurations {
        default = "post-ddr";

        post-ddr {
            description = "post-ddr";

            firmware = "tfa";

            loadables = "uboot", "optee", "tz_ac_config";

            signature-1 {
                algo = "sha256,rsa2048";
                key-name-hint = "dev";
                sign-images = "firmware", "loadables";
            };
        };
    };
};
```
